ENTRY(_start)

SECTIONS {
    . = 1M;
    
    .boot : ALIGN(4K) {
        *(.multiboot)
    }
    
    .text : {
        *(.text)
    }
    
    .rodata : {
        *(.rodata)
    }
    
    .data : {
        *(.data)
    }
    
    .bss : {
        *(.bss)
    }
}